## lte/alt1250/Kconfig
```kconfig
#
# For a description of the syntax of this configuration file,
# see the file kconfig-language.txt in the NuttX tools repository.
#

config LTE_ALT1250
	tristate "ALT1250 usrsock daemon"
	default n
	depends on NET_USRSOCK && MODEM_ALT1250
	select NET_USRSOCK_TCP
	select PIPES
	---help---
		Enable support for the alt1250 usrsock daemon

if LTE_ALT1250
config LTE_ALT1250_PROGNAME
	string "alt1250 program name"
	default "alt1250"

config LTE_ALT1250_PRIORITY
	int "alt1250 task priority"
	default 100

config LTE_ALT1250_STACKSIZE
	int "alt1250 stack size"
	default 2048

config LTE_ALT1250_LAUNCH_EVENT_TASK
	bool "Launches an internal task to handle events"
	default y
	---help---
		Launches an internal task to handle the event.
		It is also possible to disable this option and handle events with a user task.
		If disabled, use lapi_evtinit() and lapi_evtyield().

if LTE_ALT1250_LAUNCH_EVENT_TASK

config LTE_ALT1250_EVENT_TASK_PRIORITY
	int "internal task priority"
	default 100

config LTE_ALT1250_EVENT_TASK_STACKSIZE
	int "internal task stack size"
	default 2048

endif

config LTE_ALT1250_DEBUG_MSG
	bool "Enable debug output messages"
	default n

endif
```

## lte/lapi/Kconfig
```kconfig
#
# For a description of the syntax of this configuration file,
# see the file kconfig-language.txt in the NuttX tools repository.
#

menuconfig LTE_LAPI
	bool "LTE Configuration Library"
	default n
	---help---
		Enable the LTE Configuration Library.

if LTE_LAPI

config LTE_LAPI_DEBUG_MSG
	bool "Enable debug output messages"
	default n
	depends on DEBUG_NET_ERROR

config LTE_LAPI_KEEP_COMPATIBILITY
	bool "Keep the LTE library compatible."
	default n
	---help---
		lte_get_operator_sync, lte_get_imsi_sync, lte_get_imei_sync, lte_get_phoneno_sync,
		these functions have changed their specifications to specify the length of the 
		argument string. Functions in the old spec will be discarded, but enabling this
		option makes you be able to use them.
		Furthermore, this option will be removed in the near future, and functions in
		the old spec will be completely discarded.

config LTE_LAPI_LOG_ACCESS
	bool "Enable the log access API"
	default n
	---help---
		Enable these log access APIs: lte_log_open, lte_log_close,
		lte_log_read, lte_log_lseek, lte_log_remove.

endif
```

## netutils/webclient/Kconfig
```kconfig
#
# For a description of the syntax of this configuration file,
# see the file kconfig-language.txt in the NuttX tools repository.
#

config NETUTILS_WEBCLIENT
	bool "uIP web client"
	default n
	depends on NET_TCP
	select LIBC_NETDB
	select NET_SOCKOPTS
	select NETUTILS_NETLIB_GENERICURLPARSER
	---help---
		Enable support for the uIP web client.

if NETUTILS_WEBCLIENT

config NSH_WGET_USERAGENT
	string "wget User Agent"
	default "NuttX/6.xx.x (; http://www.nuttx.org/)"

config WEBCLIENT_TIMEOUT
	int "Request and receive timeouts"
	default 10

config WEBCLIENT_USE_SSL
	bool "Use SSL to enable access to https://"
	default n
	---help---
		Enable to use SSL connection for https:// access.
		This configuration requires get_sslsocket_methods() implementation on the platform.
		Without it, this flag makes BUILD ERROR.

endif
```

## netutils/wiznet/Kconfig
```kconfig
#
# For a description of the syntax of this configuration file,
# see the file kconfig-language.txt in the NuttX tools repository.
#

config NETUTILS_WIZNET
	tristate "WIZnet W5x00 usrsock daemon"
	default n
	depends on NET_USRSOCK && NET_WIZNET
	select NET_USRSOCK_TCP
	select PIPES
	select NET_USRSOCK_OTHER
	---help---
		Enable support for the WIZnet usrsock daemon

if NETUTILS_WIZNET

config NETUTILS_WIZNET_DEFAULT_MAC_ADDR
	hex "Default device MAC address"
	default 0x021a80000000
	---help---
	  Default MAC address. This can be changed by command line option.

config NETUTILS_WIZNET_ENABLE_DHCP
	bool "Use WIZnet DHCP client"
	default y

if !NETUTILS_WIZNET_ENABLE_DHCP

config NETUTILS_WIZNET_IP_ADDR
	string "WIZnet IP address"
	default "192.168.0.100"

config NETUTILS_WIZNET_SUBNET_MASK
	string "WIZnet subnet mask"
	default "255.255.255.0"

config NETUTILS_WIZNET_GATEWAY_ADDR
	string "WIZnet gateway address"
	default "192.168.0.1"

config NETUTILS_WIZNET_DNS_ADDR
	string "WIZnet DNS server address"
	default "192.168.0.1"

endif #!NETUTILS_WIZNET_ENABLE_DHCP

config NETUTILS_WIZNET_PROGNAME
	string "wiznet program name"
	default "wiznet"

config NETUTILS_WIZNET_PRIORITY
	int "wiznet task priority"
	default 50

config NETUTILS_WIZNET_STACKSIZE
	int "wiznet stack size"
	default 2048

endif # NETUTILS_WIZNET
```
